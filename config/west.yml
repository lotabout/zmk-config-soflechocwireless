## config/west.yml
```yaml
manifest:
  remotes:
    - name: zmkfirmware
      url-base: https://github.com/zmkfirmware
    - name: dhruvinsh
      url-base: https://github.com/dhruvinsh
    # - name: urob
    #   url-base: https://github.com/urob
  projects:
    - name: zmk
      remote: zmkfirmware
      revision: v0.3
      import: app/west.yml
    - name: zmk-tri-state
      remote: dhruvinsh
      revision: main
    # - name: zmk-leader-key
    #   remote: urob
    #   revision: v0.3 # Should match ZMK release.
  self:
    path: config
```
